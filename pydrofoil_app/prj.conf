## CMakeLists.txt
```
# SPDX-License-Identifier: Apache-2.0

# 1. Require a modern CMake version (matches Zephyr's requirements)
cmake_minimum_required(VERSION 3.20.0)

# 2. Inject your custom out-of-tree hardware modules BEFORE finding Zephyr.
# This ensures Zephyr's build system discovers your custom_uart Kconfig 
# and CMakeLists.txt during its initial workspace scan.
list(APPEND EXTRA_ZEPHYR_MODULES ${CMAKE_CURRENT_SOURCE_DIR}/../zephyr_modules/custom_uart)


# 3. Pull in the Zephyr OS build system
find_package(Zephyr REQUIRED HINTS $ENV{ZEPHYR_BASE})

# 4. Name your application project
project(pydrofoil_app)

# 5. Add your source files to the Zephyr 'app' target
target_sources(app PRIVATE src/main.c)

# 6. Optional IS parameters from the command line (used by build_is.sh),
# otherwise the defaults in main.c / array_include.h apply:
#   west build ... -- -DIS_NUM_CORES=4 -DIS_CLASS=W
if(DEFINED IS_NUM_CORES)
  target_compile_definitions(app PRIVATE NUM_CORES=${IS_NUM_CORES})
endif()
if(DEFINED IS_CLASS)
  target_compile_definitions(app PRIVATE "CLASS='${IS_CLASS}'")
endif()
```

## prj.conf
```kconfig
CONFIG_SERIAL=y
CONFIG_UART_PYDROFOIL=y
CONFIG_MULTI_LEVEL_INTERRUPTS=n
CONFIG_SMP=y
CONFIG_MP_MAX_NUM_CPUS=8
CONFIG_THREAD_NAME=y
CONFIG_CBPRINTF_FP_SUPPORT=y
CONFIG_FPU=n
CONFIG_RISCV_MACHINE_TIMER=y

#This slows down 
CONFIG_SYS_CLOCK_EXISTS=y



# This e.g. changes the timer compare value
CONFIG_SYS_CLOCK_HW_CYCLES_PER_SEC=10000000
CONFIG_SYS_CLOCK_TICKS_PER_SEC=100
```

## src/main.c
```c
#include <zephyr/kernel.h>
#include <zephyr/sys/printk.h>
#include <stdlib.h>
#include <stdint.h>
/* --- HIER WIRD DAS ARRAY GELADEN --- */
#include "array_include.h"
INT_TYPE *key_buff_ptr_global;
/* ----------------------------------- */

#define USE_BUCKETS
#define MULTICORE_SIMDEV_CORE_DONE (*(volatile unsigned int *)(0x1C203000))
/* 32-Bit Cast Fix, um den %u Fehler zu vermeiden */
#define MULTICORE_SIM_DEV_GET_SIM_TIME ((uint32_t)(*(volatile uint64_t *)(0x1C203020)))
#define SIMDEV_BASE      0x1E203000
#define SIMDEV_EXIT      (*(volatile uint32_t *)(SIMDEV_BASE + 0x08)) // beendet die Simulation
#define SIMDEV_SIM_TIME  (*(volatile uint64_t *)(SIMDEV_BASE + 0x18))

/*
 * Anzahl der Cores für die Parallelisierung.
 * Erlaubte Werte: 1, 2, 4, 8
 * Von außen setzbar: west build ... -- -DIS_NUM_CORES=<n> (siehe build_is.sh)
 */
#ifndef NUM_CORES
#define NUM_CORES 8
#endif

#if (NUM_CORES != 1) && (NUM_CORES != 2) && (NUM_CORES != 4) && (NUM_CORES != 8)
#error "NUM_CORES must be 1, 2, 4, or 8"
#endif

#if (NUM_KEYS % NUM_CORES) != 0
#error "NUM_KEYS must be divisible by NUM_CORES"
#endif

#if (NUM_BUCKETS % NUM_CORES) != 0
#error "NUM_BUCKETS must be divisible by NUM_CORES"
#endif

#define KEYS_PER_CORE    (NUM_KEYS / NUM_CORES)
#define BUCKETS_PER_CORE (NUM_BUCKETS / NUM_CORES)

int      passed_verification;

/* --- Zephyr SMP Threading Setup --- */
#define STACK_SIZE 4096
#define THREAD_PRIORITY 7

#if NUM_CORES > 1
K_THREAD_STACK_ARRAY_DEFINE(worker_stacks, NUM_CORES - 1, STACK_SIZE);
static struct k_thread worker_thread_data[NUM_CORES - 1];
static struct k_sem start_sem[NUM_CORES - 1];
static struct k_sem done_sem[NUM_CORES - 1];
#endif

/* TRICK 1: 2D Array für konfliktfreies Zählen (eine Zeile pro Core) */
INT_TYPE bucket_size[NUM_CORES][NUM_BUCKETS];
INT_TYPE global_bucket_ptrs[NUM_BUCKETS];
INT_TYPE local_bucket_ptrs[NUM_CORES][NUM_BUCKETS];

/* The large static arrays */
INT_TYPE key_buff1[MAX_KEY],    
         key_buff2[SIZE_OF_BUFFERS],
         partial_verify_vals[TEST_ARRAY_SIZE];

INT_TYPE test_index_array[TEST_ARRAY_SIZE],
         test_rank_array[TEST_ARRAY_SIZE],
         S_test_index_array[TEST_ARRAY_SIZE] = {48427,17148,23627,62548,4431},
         S_test_rank_array[TEST_ARRAY_SIZE]  = {0,18,346,64917,65463};

/* Portable random number generator */
double randlc(double *X, double *A) {
      static int KS = 0;
      static double R23, R46, T23, T46;
      double T1, T2, T3, T4, A1, A2, X1, X2, Z;
      int i, j;

      if (KS == 0) {
        R23 = 1.0; R46 = 1.0; T23 = 1.0; T46 = 1.0;
        for (i=1; i<=23; i++) { R23 = 0.50 * R23; T23 = 2.0 * T23; }
        for (i=1; i<=46; i++) { R46 = 0.50 * R46; T46 = 2.0 * T46; }
        KS = 1;
      }

      T1 = R23 * *A; j = T1; A1 = j; A2 = *A - T23 * A1;
      T1 = R23 * *X; j = T1; X1 = j; X2 = *X - T23 * X1;
      T1 = A1 * X2 + A2 * X1;
      
      j  = R23 * T1; T2 = j; Z = T1 - T23 * T2;
      T3 = T23 * Z + A2 * X2;
      j  = R46 * T3; T4 = j; *X = T3 - T46 * T4;
      return(R46 * *X);
} 

void print_hard_id(void) {
    uint32_t hard_id = arch_proc_id();
    printk("Executing on Hardware Core ID: 0x%08X\n", hard_id);
}

static void signal_workers_start(void) {
#if NUM_CORES > 1
    for (int c = 0; c < NUM_CORES - 1; c++) {
        k_sem_give(&start_sem[c]);
    }
#endif
}

static void wait_workers_done(void) {
#if NUM_CORES > 1
    for (int c = 0; c < NUM_CORES - 1; c++) {
        k_sem_take(&done_sem[c], K_FOREVER);
    }
#endif
}

/* Startindex von Core C in Bucket i (keys der Cores liegen pro Bucket hintereinander) */
static void compute_local_bucket_ptrs(int core_id) {
    INT_TYPE sum = 0;

    for (int c = 0; c < core_id; c++) {
        sum += bucket_size[c][0];
    }
    local_bucket_ptrs[core_id][0] = sum;

    for (int i = 1; i < NUM_BUCKETS; i++) {
        INT_TYPE add = 0;
        for (int c = core_id; c < NUM_CORES; c++) {
            add += bucket_size[c][i - 1];
        }
        for (int c = 0; c < core_id; c++) {
            add += bucket_size[c][i];
        }
        local_bucket_ptrs[core_id][i] = local_bucket_ptrs[core_id][i - 1] + add;
    }
}

static void compute_global_bucket_ptrs(void) {
    INT_TYPE sum = 0;

    for (int c = 0; c < NUM_CORES; c++) {
        sum += bucket_size[c][0];
    }
    global_bucket_ptrs[0] = sum;

    for (int i = 1; i < NUM_BUCKETS; i++) {
        sum = global_bucket_ptrs[i - 1];
        for (int c = 0; c < NUM_CORES; c++) {
            sum += bucket_size[c][i];
        }
        global_bucket_ptrs[i] = sum;
    }
}

static void count_keys(int core_id, int shift) {
    int key_start = core_id * KEYS_PER_CORE;
    int key_end = key_start + KEYS_PER_CORE;
    // printk("DEBUG::Core %d, with hartid 0x%08X counting keys from %d to %d\n", core_id, arch_proc_id(), key_start, key_end - 1);

    for (int i = 0; i < NUM_BUCKETS; i++) {
        bucket_size[core_id][i] = 0;
    }
    for (int i = key_start; i < key_end; i++) {
        bucket_size[core_id][key_array[i] >> shift]++;
    }
}

static void scatter_keys(int core_id, int shift) {
    int key_start = core_id * KEYS_PER_CORE;
    int key_end = key_start + KEYS_PER_CORE;

    compute_local_bucket_ptrs(core_id);

    for (int i = key_start; i < key_end; i++) {
        INT_TYPE key = key_array[i];
        key_buff2[local_bucket_ptrs[core_id][key >> shift]++] = key;
    }
}

static void final_rank_buckets(int core_id, int num_bucket_keys) {
    int bucket_start = core_id * BUCKETS_PER_CORE;
    int bucket_end = bucket_start + BUCKETS_PER_CORE;

    for (int i = bucket_start; i < bucket_end; i++) {
        INT_TYPE k1 = i * num_bucket_keys;
        INT_TYPE k2 = k1 + num_bucket_keys;

        for (INT_TYPE k = k1; k < k2; k++) {
            key_buff1[k] = 0;
        }

        INT_TYPE m = (i > 0) ? global_bucket_ptrs[i - 1] : 0;
        for (INT_TYPE k = m; k < global_bucket_ptrs[i]; k++) {
            key_buff1[key_buff2[k]]++;
        }

        key_buff1[k1] += m;
        for (INT_TYPE k = k1 + 1; k < k2; k++) {
            key_buff1[k] += key_buff1[k - 1];
        }
    }
}

#if NUM_CORES > 1
/* Worker-Thread für Core 1 .. NUM_CORES-1 */
void worker_thread(void *arg1, void *arg2, void *arg3) {
    int core_id = (int)(uintptr_t)arg1;
    int sem_idx = core_id - 1;
    int shift = MAX_KEY_LOG_2 - NUM_BUCKETS_LOG_2;
    int num_bucket_keys = (1 << shift);

    printk("DEBUG::Worker core %d running on hartid: 0x%08X\n",
           core_id, arch_proc_id());

    while (1) {
        /* ================= PHASE 1: COUNTING ================= */
        k_sem_take(&start_sem[sem_idx], K_FOREVER);
        count_keys(core_id, shift);
        k_sem_give(&done_sem[sem_idx]);

        /* ================= PHASE 2/3: SCATTER ================= */
        k_sem_take(&start_sem[sem_idx], K_FOREVER);
        scatter_keys(core_id, shift);
        k_sem_give(&done_sem[sem_idx]);

        /* ================= PHASE 4: FINAL RANK ================= */
        k_sem_take(&start_sem[sem_idx], K_FOREVER);
        final_rank_buckets(core_id, num_bucket_keys);
        k_sem_give(&done_sem[sem_idx]);
    }
}
#endif

void rank(int iteration) {
    printk("DEBUG::The function rank() is executed on the core with following hartid: 0x%08X\n", arch_proc_id());
    INT_TYPE i, k;
    int shift = MAX_KEY_LOG_2 - NUM_BUCKETS_LOG_2;
    int num_bucket_keys = (1 << shift);

    key_array[iteration] = iteration;
    key_array[iteration + MAX_ITERATIONS] = MAX_KEY - iteration;

    for(i = 0; i < TEST_ARRAY_SIZE; i++){
        partial_verify_vals[i] = key_array[test_index_array[i]];
    }

    /* ================= PHASE 1: COUNTING ================= */
    signal_workers_start();
    count_keys(0, shift);
    wait_workers_done();

    /* ================= PHASE 2/3: SCATTER ================= */
    signal_workers_start();
    compute_global_bucket_ptrs();
    scatter_keys(0, shift);
    wait_workers_done();

    /* ================= PHASE 4: FINAL RANK ================= */
    signal_workers_start();
    final_rank_buckets(0, num_bucket_keys);
    wait_workers_done();

    /* ================= VERIFICATION ================= */
    for(i = 0; i < TEST_ARRAY_SIZE; i++) {   
        k = partial_verify_vals[i];          
        if(0 < k && k <= NUM_KEYS-1) {
            INT_TYPE key_rank = key_buff1[k-1];
            int failed = 0;
            if(i <= 2) {
                if(key_rank != test_rank_array[i] + iteration) failed = 1;
                else passed_verification++;
            } else {
                if(key_rank != test_rank_array[i] - iteration) failed = 1;
                else passed_verification++;
            }
        }
    }
    
    if(iteration == MAX_ITERATIONS) key_buff_ptr_global = key_buff1;
}      


void full_verify(void) {
    INT_TYPE i, j;
    for(i = 0; i < NUM_KEYS; i++) {
        key_array[--key_buff_ptr_global[key_buff2[i]]] = key_buff2[i];
    }
    
    j = 0;
    for(i = 1; i < NUM_KEYS; i++) {
        if(key_array[i-1] > key_array[i]) j++;
    }

    // if(j != 0) 
    // //  printk("Full_verify: keys out of sort: %d\n", j);
    passed_verification++;
}


int main(void) {
    int i, iteration;
    uint32_t start_time, end_time;
    printk("DEBUG::The function main() is executed on the core with following hartid: 0x%08X\n", arch_proc_id());

    for(i = 0; i < TEST_ARRAY_SIZE; i++) {
        test_index_array[i] = S_test_index_array[i];
        test_rank_array[i]  = S_test_rank_array[i];
    }

    printk("\n\n NAS Parallel Benchmarks (Zephyr SMP) - IS Benchmark\n");
    printk(" Size:  %d  (class %c)\n", TOTAL_KEYS, CLASS);
    printk(" Iterations:   %d\n", MAX_ITERATIONS);
    printk(" Cores:        %d\n", NUM_CORES);

#if NUM_CORES > 1
    for (int c = 0; c < NUM_CORES - 1; c++) {
        k_sem_init(&start_sem[c], 0, 1);
        k_sem_init(&done_sem[c], 0, 1);
    }

    for (int c = 1; c < NUM_CORES; c++) {
        k_thread_create(&worker_thread_data[c - 1], worker_stacks[c - 1],
                        K_THREAD_STACK_SIZEOF(worker_stacks[c - 1]),
                        worker_thread, (void *)(uintptr_t)c, NULL, NULL,
                        THREAD_PRIORITY, 0, K_NO_WAIT);
    }
#endif

    // create_seq(314159265.00, 1220703125.00);                 

    passed_verification = 0;
    
    /* Untimed initial rank */
    // rank(1);  
    // printk("Initialization done, counting time\n\n");
    
    start_time = MULTICORE_SIM_DEV_GET_SIM_TIME;
    
    for(iteration = 1; iteration <= MAX_ITERATIONS; iteration++) {
        printk("   Iteration %d\n", iteration);
        rank(iteration);
    }

    full_verify();

    printk("\n===================================\n");
    printk("===================================\n");
    
    
    // printk("\n--- Komplettes Sorted Array ---\n");
    // for (int idx = 0; idx < NUM_KEYS; idx++) {
    //     /* Kuerzere Ausgabe, um die Zeilenanzahl/Zeit zu minimieren */
    //     printk("%d\n", key_array[idx]);
    // }
    // printk("-------------------------------\n");
    for (int c = 0; c < NUM_CORES; c++) {
        MULTICORE_SIMDEV_CORE_DONE = c;     
    }
    
    return 0;
}
```

## src/array_class_m.h
```c
#ifndef ARRAY_CLASS_M_H
#define ARRAY_CLASS_M_H

#define  TOTAL_KEYS_LOG_2    12  // 4,096 keys (down from 65,536)
#define  MAX_KEY_LOG_2       9   // Max key 512
#define  NUM_BUCKETS_LOG_2   7   // 128 buckets

INT_TYPE key_array[] = {
    352, 253, 211, 195, 206, 199, 259, 250, 246, 219, 192, 211, 311, 240, 266, 
    363, 143, 131, 99, 141, 278, 331, 252, 285, 290, 199, 224, 159, 219, 284, 
    342, 324, 145, 354, 182, 402, 270, 379, 212, 245, 187, 217, 278, 199, 134, 
    124, 274, 240, 253, 223, 211, 325, 171, 143, 295, 339, 256, 297, 330, 332, 
    344, 221, 132, 341, 230, 162, 235, 162, 205, 255, 281, 406, 345, 283, 281, 
    318, 370, 356, 274, 342, 187, 286, 290, 220, 242, 194, 255, 264, 388, 238, 
    295, 99, 180, 305, 318, 208, 335, 304, 127, 187, 196, 308, 336, 188, 210, 
    242, 384, 390, 283, 364, 330, 311, 163, 245, 381, 239, 216, 235, 386, 300, 
    281, 185, 197, 201, 157, 368, 297, 295, 301, 242, 298, 200, 235, 153, 318, 
    318, 219, 203, 308, 227, 198, 273, 177, 330, 272, 215, 298, 96, 255, 168, 
    200, 336, 334, 321, 331, 293, 353, 174, 127, 261, 172, 266, 220, 184, 235, 
    302, 188, 195, 297, 382, 120, 326, 360, 334, 422, 143, 230, 329, 261, 191, 
    208, 209, 282, 94, 242, 230, 240, 306, 205, 292, 174, 261, 187, 104, 267, 
    262, 270, 341, 326, 330, 281, 352, 340, 342, 317, 195, 317, 265, 272, 303, 
    250, 262, 200, 324, 204, 174, 277, 258, 292, 174, 126, 250, 215, 130, 347, 
    188, 293, 288, 268, 201, 269, 304, 202, 146, 191, 339, 392, 265, 245, 274, 
    161, 227, 276, 344, 200, 345, 172, 246, 204, 252, 407, 221, 227, 262, 237, 
    219, 272, 278, 186, 303, 231, 307, 332, 131, 314, 201, 191, 184, 219, 316, 
    256, 76, 398, 260, 163, 221, 366, 298, 154, 286, 227, 187, 368, 259, 220, 
    156, 318, 176, 273, 243, 335, 264, 179, 323, 259, 184, 227, 214, 206, 291, 
    321, 241, 211, 213, 242, 221, 272, 338, 318, 141, 280, 280, 222, 429, 348, 
    309, 276, 309, 156, 268, 144, 329, 207, 273, 159, 177, 160, 222, 188, 170, 
    178, 268, 132, 326, 184, 69, 259, 246, 346, 285, 92, 274, 306, 271, 209, 
    212, 315, 237, 133, 116, 224, 289, 283, 367, 339, 276, 253, 406, 235, 250, 
    367, 296, 211, 302, 139, 243, 370, 392, 289, 208, 123, 225, 296, 310, 355, 
    364, 268, 192, 188, 238, 287, 151, 284, 303, 104, 270, 222, 267, 245, 157, 
    191, 351, 202, 259, 381, 296, 361, 245, 334, 370, 189, 245, 315, 192, 204, 
    351, 303, 92, 230, 196, 308, 129, 345, 194, 282, 178, 280, 216, 216, 253, 
    225, 256, 216, 237, 98, 378, 204, 369, 217, 421, 337, 321, 298, 259, 279, 
    207, 254, 302, 409, 371, 217, 234, 220, 293, 189, 406, 200, 216, 318, 270, 
    324, 441, 288, 268, 131, 185, 173, 163, 301, 201, 268, 339, 332, 158, 267, 
    412, 126, 177, 218, 206, 366, 255, 276, 287, 270, 343, 247, 247, 186, 260, 
    418, 186, 348, 294, 294, 280, 332, 357, 134, 149, 276, 390, 177, 258, 244, 
    164, 158, 106, 289, 326, 300, 205, 259, 310, 288, 364, 325, 300, 250, 303, 
    267, 314, 289, 315, 297, 291, 320, 93, 293, 291, 319, 194, 248, 238, 321, 
    345, 226, 256, 367, 156, 353, 245, 286, 247, 181, 295, 337, 277, 344, 195, 
    320, 171, 356, 177, 149, 305, 341, 237, 265, 385, 314, 98, 220, 171, 85, 
    239, 243, 207, 250, 170, 310, 196, 393, 212, 213, 325, 255, 331, 262, 196, 
    155, 313, 323, 251, 148, 342, 279, 275, 372, 266, 239, 361, 213, 239, 169, 
    263, 259, 355, 346, 348, 247, 241, 154, 283, 267, 102, 245, 256, 357, 192, 
    292, 407, 268, 317, 154, 215, 259, 129, 107, 320, 264, 341, 196, 322, 279, 
    238, 309, 175, 72, 350, 390, 262, 240, 157, 242, 188, 270, 299, 233, 205, 
    195, 294, 353, 375, 274, 259, 285, 255, 328, 339, 245, 114, 144, 212, 338, 
    176, 230, 221, 264, 314, 230, 196, 156, 273, 301, 249, 189, 406, 239, 241, 
    207, 354, 139, 248, 246, 307, 146, 225, 177, 294, 301, 186, 218, 167, 208, 
    299, 302, 278, 241, 190, 319, 217, 324, 245, 273, 164, 211, 432, 254, 244, 
    172, 268, 337, 299, 281, 208, 229, 267, 238, 207, 293, 345, 227, 161, 184, 
    218, 382, 161, 429, 292, 205, 133, 188, 218, 288, 230, 213, 202, 279, 250, 
    210, 361, 254, 354, 357, 192, 208, 337, 236, 352, 371, 176, 204, 276, 360, 
    314, 223, 267, 322, 156, 367, 127, 404, 268, 75, 289, 351, 112, 219, 252, 
    255, 325, 235, 260, 234, 228, 258, 216, 193, 285, 416, 218, 189, 224, 105, 
    81, 346, 346, 67, 145, 154, 195, 275, 298, 250, 272, 287, 279, 221, 65, 
    281, 248, 236, 198, 218, 238, 176, 224, 293, 287, 238, 210, 242, 247, 252, 
    130, 213, 295, 243, 317, 125, 298, 284, 228, 280, 368, 277, 355, 126, 236, 
    331, 286, 333, 155, 393, 285, 150, 232, 269, 248, 300, 334, 187, 293, 319, 
    274, 235, 256, 250, 159, 230, 388, 403, 266, 211, 312, 331, 255, 373, 239, 
    216, 165, 332, 147, 334, 248, 221, 333, 261, 218, 186, 359, 275, 203, 360, 
    244, 153, 308, 204, 217, 469, 191, 230, 244, 284, 260, 288, 336, 273, 270, 
    378, 224, 270, 233, 200, 447, 287, 245, 202, 346, 161, 223, 198, 319, 337, 
    324, 279, 349, 251, 328, 232, 254, 268, 300, 305, 131, 177, 240, 249, 315, 
    213, 236, 259, 315, 213, 193, 228, 300, 252, 298, 263, 213, 297, 233, 268, 
    173, 412, 212, 265, 230, 314, 331, 227, 183, 77, 214, 231, 362, 346, 220, 
    253, 272, 222, 191, 295, 89, 196, 313, 377, 229, 293, 173, 213, 208, 181, 
    243, 209, 417, 181, 325, 277, 335, 116, 282, 419, 225, 367, 308, 261, 324, 
    317, 343, 239, 249, 317, 409, 290, 203, 328, 289, 267, 301, 97, 233, 290, 
    149, 262, 348, 125, 286, 312, 176, 297, 177, 284, 254, 271, 147, 397, 309, 
    415, 215, 341, 177, 169, 172, 228, 288, 280, 256, 327, 289, 257, 219, 326, 
    140, 195, 178, 147, 317, 287, 230, 299, 220, 121, 233, 210, 180, 132, 249, 
    332, 239, 311, 199, 185, 269, 95, 249, 331, 260, 277, 256, 317, 230, 296, 
    264, 215, 278, 356, 163, 168, 311, 221, 109, 280, 196, 279, 296, 220, 300, 
    272, 407, 300, 317, 324, 317, 211, 216, 302, 175, 347, 122, 267, 377, 310, 
    344, 235, 292, 307, 394, 190, 149, 248, 184, 335, 276, 132, 209, 326, 364, 
    258, 277, 239, 187, 324, 219, 219, 251, 296, 263, 184, 300, 275, 318, 272, 
    255, 242, 175, 235, 153, 202, 347, 167, 216, 264, 265, 288, 158, 120, 225, 
    181, 188, 230, 314, 343, 392, 248, 112, 169, 368, 230, 261, 152, 377, 297, 
    261, 264, 352, 220, 411, 300, 262, 207, 382, 288, 225, 208, 207, 372, 222, 
    338, 282, 287, 354, 327, 234, 176, 350, 259, 191, 297, 265, 335, 173, 190, 
    195, 405, 392, 286, 281, 120, 259, 215, 253, 240, 224, 282, 225, 205, 228, 
    415, 207, 327, 232, 227, 146, 258, 358, 203, 176, 249, 192, 88, 139, 179, 
    333, 281, 338, 281, 262, 361, 277, 256, 244, 197, 358, 382, 256, 220, 248, 
    282, 280, 124, 235, 273, 261, 316, 273, 282, 341, 331, 91, 132, 106, 303, 
    293, 104, 281, 317, 206, 233, 284, 109, 287, 198, 258, 354, 239, 301, 339, 
    280, 278, 245, 301, 279, 361, 385, 324, 158, 296, 333, 304, 178, 163, 251, 
    255, 281, 304, 268, 186, 190, 331, 284, 297, 180, 181, 239, 245, 213, 140, 
    231, 264, 301, 226, 104, 280, 357, 288, 249, 295, 229, 275, 201, 144, 237, 
    323, 314, 108, 279, 77, 229, 277, 197, 277, 194, 327, 184, 249, 121, 244, 
    278, 220, 363, 223, 321, 233, 346, 310, 176, 228, 265, 288, 267, 243, 251, 
    211, 244, 272, 96, 383, 256, 273, 254, 262, 151, 182, 361, 192, 218, 106, 
    293, 258, 280, 405, 286, 299, 301, 273, 412, 300, 228, 154, 268, 349, 223, 
    169, 192, 238, 191, 218, 261, 205, 180, 340, 292, 300, 215, 320, 209, 184, 
    174, 232, 305, 228, 180, 263, 404, 302, 319, 386, 257, 332, 344, 77, 182, 
    342, 240, 291, 230, 160, 329, 348, 252, 307, 173, 191, 225, 163, 310, 228, 
    175, 246, 256, 327, 256, 287, 314, 216, 177, 352, 408, 271, 266, 275, 176, 
    405, 219, 144, 235, 257, 203, 295, 263, 254, 312, 189, 323, 141, 180, 410, 
    271, 181, 336, 256, 325, 279, 96, 287, 267, 266, 347, 357, 303, 309, 189, 
    248, 265, 343, 155, 314, 141, 370, 312, 369, 287, 330, 315, 371, 349, 232, 
    343, 198, 317, 255, 281, 338, 226, 184, 278, 253, 204, 288, 307, 317, 195, 
    246, 257, 329, 169, 324, 243, 248, 303, 153, 230, 324, 376, 342, 260, 193, 
    213, 355, 226, 267, 86, 353, 342, 191, 263, 272, 288, 201, 281, 277, 277, 
    99, 180, 306, 294, 223, 120, 194, 246, 136, 91, 307, 372, 218, 251, 97, 
    204, 263, 282, 309, 289, 232, 270, 165, 315, 308, 211, 208, 331, 232, 255, 
    320, 264, 182, 148, 252, 187, 234, 353, 246, 240, 339, 263, 268, 248, 286, 
    238, 307, 314, 333, 204, 376, 149, 303, 359, 307, 189, 304, 296, 172, 210, 
    209, 240, 265, 257, 136, 238, 267, 87, 267, 264, 387, 184, 175, 225, 294, 
    126, 373, 201, 322, 155, 245, 176, 394, 157, 266, 278, 308, 117, 247, 276, 
    187, 270, 351, 214, 299, 266, 207, 222, 333, 371, 158, 92, 322, 186, 265, 
    207, 319, 264, 209, 173, 160, 345, 151, 363, 79, 232, 305, 161, 214, 251, 
    231, 248, 258, 298, 318, 282, 323, 266, 322, 423, 293, 262, 293, 203, 203, 
    163, 350, 311, 403, 281, 96, 358, 242, 392, 166, 297, 160, 296, 271, 262, 
    309, 323, 354, 284, 205, 264, 362, 246, 253, 349, 245, 221, 401, 163, 204, 
    298, 195, 224, 350, 205, 189, 276, 271, 292, 317, 266, 351, 302, 152, 252, 
    308, 202, 265, 232, 444, 157, 279, 252, 276, 353, 361, 251, 378, 321, 405, 
    351, 188, 169, 316, 277, 314, 228, 128, 330, 379, 170, 303, 332, 205, 129, 
    265, 279, 148, 275, 239, 206, 411, 309, 189, 359, 295, 114, 310, 240, 292, 
    146, 242, 197, 220, 147, 288, 298, 346, 342, 231, 302, 203, 112, 268, 310, 
    315, 301, 323, 210, 290, 341, 141, 407, 275, 205, 171, 393, 329, 190, 255, 
    209, 234, 257, 263, 297, 329, 224, 213, 232, 171, 250, 144, 146, 285, 234, 
    225, 264, 255, 235, 158, 254, 257, 284, 264, 273, 384, 201, 243, 337, 312, 
    193, 369, 205, 329, 150, 258, 359, 200, 364, 429, 126, 200, 298, 292, 146, 
    253, 360, 228, 257, 271, 284, 183, 324, 146, 330, 270, 251, 333, 74, 232, 
    353, 401, 394, 190, 348, 207, 165, 315, 108, 415, 287, 240, 240, 231, 149, 
    353, 250, 209, 341, 214, 415, 146, 266, 117, 175, 244, 270, 209, 101, 239, 
    335, 231, 224, 118, 281, 383, 324, 367, 248, 281, 278, 242, 308, 140, 141, 
    311, 232, 74, 310, 314, 191, 300, 167, 342, 181, 230, 337, 250, 412, 246, 
    208, 308, 368, 195, 192, 307, 294, 187, 456, 378, 306, 264, 263, 251, 303, 
    286, 257, 149, 255, 378, 246, 220, 214, 223, 226, 267, 363, 210, 170, 250, 
    267, 291, 157, 339, 230, 270, 303, 149, 198, 405, 253, 423, 250, 324, 276, 
    351, 312, 289, 330, 267, 210, 238, 330, 290, 266, 345, 177, 271, 202, 292, 
    298, 358, 226, 346, 229, 406, 309, 294, 277, 367, 150, 445, 202, 204, 234, 
    314, 251, 195, 211, 257, 315, 377, 190, 258, 284, 162, 294, 210, 89, 154, 
    250, 246, 262, 285, 235, 273, 299, 358, 309, 289, 185, 315, 171, 406, 364, 
    236, 337, 190, 237, 181, 129, 414, 192, 262, 375, 304, 368, 345, 228, 100, 
    330, 265, 308, 134, 229, 240, 302, 329, 125, 125, 367, 261, 216, 295, 194, 
    247, 158, 207, 211, 304, 358, 184, 106, 328, 196, 241, 193, 135, 335, 108, 
    262, 301, 268, 150, 208, 284, 260, 345, 169, 248, 355, 233, 259, 340, 282, 
    213, 335, 199, 209, 242, 283, 387, 173, 301, 256, 239, 291, 332, 162, 121, 
    333, 267, 254, 424, 242, 324, 256, 282, 155, 225, 269, 252, 254, 222, 288, 
    270, 271, 224, 399, 235, 164, 353, 245, 245, 294, 148, 281, 163, 265, 279, 
    149, 361, 218, 327, 99, 225, 160, 221, 151, 401, 299, 242, 255, 271, 222, 
    361, 169, 222, 145, 327, 153, 373, 209, 308, 288, 303, 152, 327, 289, 202, 
    249, 325, 180, 266, 193, 162, 336, 408, 299, 324, 298, 220, 323, 368, 141, 
    173, 262, 181, 229, 201, 269, 229, 356, 265, 168, 267, 201, 132, 319, 234, 
    282, 225, 366, 202, 189, 258, 294, 293, 355, 288, 358, 226, 198, 214, 147, 
    296, 99, 260, 278, 294, 296, 255, 265, 172, 233, 268, 194, 293, 363, 343, 
    244, 148, 217, 226, 351, 262, 345, 230, 299, 230, 303, 293, 236, 326, 260, 
    297, 318, 211, 204, 307, 304, 237, 182, 198, 220, 280, 192, 191, 203, 409, 
    256, 276, 369, 261, 249, 170, 314, 225, 204, 268, 292, 365, 138, 285, 124, 
    367, 291, 381, 245, 302, 185, 214, 318, 302, 277, 226, 306, 289, 257, 324, 
    258, 238, 347, 168, 282, 318, 319, 323, 256, 231, 245, 307, 263, 348, 276, 
    298, 268, 166, 145, 153, 216, 172, 261, 257, 300, 424, 252, 183, 254, 228, 
    245, 321, 177, 62, 231, 142, 238, 412, 414, 209, 329, 199, 184, 252, 250, 
    259, 293, 214, 330, 298, 288, 219, 194, 392, 225, 284, 295, 188, 169, 337, 
    264, 364, 218, 247, 266, 377, 284, 311, 321, 274, 244, 371, 298, 256, 286, 
    105, 169, 245, 289, 180, 206, 340, 245, 349, 324, 320, 159, 279, 293, 396, 
    182, 386, 184, 254, 270, 276, 165, 152, 325, 176, 235, 257, 227, 302, 412, 
    195, 260, 323, 234, 164, 134, 305, 423, 171, 152, 166, 259, 231, 91, 270, 
    273, 344, 373, 301, 166, 329, 223, 262, 341, 365, 171, 221, 348, 269, 185, 
    139, 293, 244, 262, 228, 186, 380, 200, 347, 264, 152, 315, 228, 321, 268, 
    440, 345, 235, 236, 150, 290, 243, 239, 329, 285, 181, 292, 287, 162, 340, 
    262, 211, 207, 208, 281, 231, 80, 266, 155, 238, 349, 253, 168, 224, 97, 
    253, 291, 106, 457, 148, 295, 355, 269, 116, 318, 335, 226, 135, 455, 325, 
    242, 121, 412, 210, 261, 274, 142, 313, 221, 183, 199, 248, 210, 287, 176, 
    240, 160, 305, 166, 259, 223, 320, 203, 223, 209, 354, 284, 253, 243, 338, 
    309, 400, 196, 119, 120, 296, 295, 142, 269, 226, 215, 419, 269, 291, 266, 
    102, 195, 303, 256, 214, 190, 243, 220, 312, 205, 244, 140, 259, 321, 391, 
    221, 196, 240, 172, 350, 308, 236, 230, 215, 225, 152, 252, 167, 306, 205, 
    318, 216, 216, 285, 266, 132, 378, 302, 138, 283, 297, 220, 332, 281, 121, 
    239, 319, 227, 155, 403, 309, 342, 309, 251, 336, 220, 118, 175, 256, 246, 
    166, 268, 316, 138, 261, 268, 210, 358, 209, 400, 292, 319, 275, 246, 215, 
    296, 309, 192, 265, 160, 265, 163, 156, 355, 242, 259, 267, 325, 250, 253, 
    323, 278, 170, 278, 312, 228, 166, 160, 361, 179, 135, 384, 234, 236, 312, 
    354, 274, 276, 245, 244, 337, 316, 145, 215, 261, 189, 163, 201, 355, 201, 
    200, 315, 36, 306, 287, 211, 225, 233, 255, 229, 301, 179, 381, 141, 216, 
    266, 313, 336, 382, 253, 246, 219, 191, 193, 235, 181, 348, 327, 345, 148, 
    290, 237, 189, 224, 104, 297, 222, 262, 301, 297, 203, 243, 77, 211, 282, 
    292, 260, 251, 278, 250, 288, 159, 216, 149, 314, 211, 142, 173, 375, 230, 
    299, 298, 155, 223, 311, 222, 455, 213, 192, 270, 114, 279, 219, 84, 252, 
    344, 221, 265, 286, 123, 401, 366, 187, 279, 143, 163, 256, 198, 206, 281, 
    205, 325, 228, 385, 142, 331, 335, 211, 114, 216, 185, 202, 349, 313, 173, 
    166, 295, 177, 253, 293, 167, 227, 218, 239, 158, 245, 346, 362, 312, 124, 
    223, 248, 381, 286, 186, 305, 343, 151, 280, 190, 385, 196, 337, 248, 183, 
    332, 309, 75, 267, 277, 344, 294, 267, 122, 301, 304, 335, 176, 298, 362, 
    205, 290, 214, 154, 336, 233, 265, 249, 274, 145, 325, 247, 282, 311, 364, 
    255, 292, 243, 180, 341, 191, 124, 118, 97, 291, 218, 126, 326, 396, 350, 
    254, 410, 147, 290, 394, 297, 256, 277, 352, 189, 268, 160, 260, 283, 195, 
    200, 225, 328, 152, 388, 288, 319, 213, 364, 193, 115, 210, 333, 339, 177, 
    283, 205, 146, 225, 317, 304, 344, 335, 316, 255, 253, 203, 290, 199, 196, 
    112, 219, 224, 144, 292, 216, 141, 368, 421, 235, 277, 327, 276, 266, 330, 
    317, 161, 237, 156, 140, 102, 331, 259, 273, 293, 164, 174, 222, 231, 253, 
    260, 356, 247, 256, 313, 326, 203, 390, 295, 312, 270, 150, 187, 268, 197, 
    233, 257, 329, 294, 191, 193, 312, 160, 210, 208, 214, 275, 171, 300, 203, 
    148, 207, 255, 261, 136, 250, 415, 238, 285, 211, 132, 251, 190, 311, 169, 
    163, 237, 390, 337, 371, 310, 236, 202, 270, 217, 294, 197, 180, 170, 345, 
    329, 315, 380, 131, 402, 334, 325, 100, 255, 203, 291, 237, 312, 288, 164, 
    227, 230, 327, 241, 218, 241, 210, 261, 253, 250, 322, 303, 129, 211, 216, 
    251, 109, 325, 303, 180, 265, 175, 384, 204, 224, 158, 391, 209, 187, 254, 
    404, 361, 294, 110, 247, 259, 350, 254, 307, 271, 302, 283, 332, 205, 206, 
    228, 176, 389, 303, 213, 292, 311, 219, 271, 310, 352, 275, 299, 141, 352, 
    150, 210, 144, 150, 393, 279, 180, 90, 189, 267, 128, 245, 262, 325, 337, 
    162, 124, 191, 196, 261, 263, 304, 301, 254, 310, 304, 445, 260, 191, 184, 
    189, 218, 175, 180, 280, 293, 167, 349, 289, 305, 272, 248, 225, 309, 120, 
    274, 311, 297, 427, 323, 232, 165, 323, 152, 311, 294, 285, 295, 175, 133, 
    310, 224, 229, 191, 373, 222, 131, 246, 385, 229, 275, 192, 292, 340, 196, 
    167, 235, 156, 130, 140, 196, 299, 281, 328, 151, 271, 284, 389, 282, 325, 
    179, 285, 211, 339, 360, 230, 235, 187, 288, 306, 343, 252, 318, 283, 88, 
    238, 220, 224, 191, 188, 210, 198, 396, 292, 305, 336, 293, 269, 302, 183, 
    221, 262, 343, 210, 295, 150, 147, 334, 262, 196, 423, 355, 266, 234, 136, 
    269, 397, 168, 222, 107, 169, 230, 190, 301, 261, 390, 265, 277, 214, 223, 
    190, 225, 260, 231, 320, 194, 290, 255, 232, 446, 239, 112, 113, 229, 298, 
    367, 277, 170, 312, 287, 209, 259, 378, 220, 199, 316, 441, 281, 291, 118, 
    131, 316, 301, 208, 321, 296, 341, 319, 80, 270, 245, 305, 251, 175, 259, 
    160, 192, 225, 277, 201, 232, 174, 161, 257, 211, 306, 114, 366, 237, 332, 
    237, 348, 224, 294, 278, 254, 211, 340, 83, 256, 345, 345, 132, 368, 338, 
    310, 248, 358, 247, 423, 275, 198, 333, 100, 338, 338, 290, 217, 315, 197, 
    279, 335, 340, 70, 327, 178, 358, 240, 156, 219, 315, 258, 263, 226, 205, 
    136, 276, 200, 307, 217, 298, 328, 148, 296, 179, 217, 334, 237, 214, 233, 
    184, 288, 178, 292, 292, 187, 262, 161, 156, 253, 179, 267, 246, 246, 205, 
    158, 237, 234, 347, 327, 274, 208, 321, 345, 306, 167, 343, 238, 324, 361, 
    192, 290, 263, 228, 242, 310, 173, 267, 220, 233, 304, 275, 303, 245, 238, 
    318, 464, 175, 273, 123, 384, 220, 293, 148, 194, 247, 262, 240, 238, 135, 
    238, 219, 313, 295, 356, 216, 315, 270, 202, 246, 151, 185, 174, 95, 294, 
    229, 353, 325, 220, 255, 265, 299, 134, 256, 353, 274, 383, 189, 289, 311, 
    333, 220, 148, 308, 258, 341, 321, 298, 328, 146, 172, 209, 307, 222, 227, 
    338, 250, 344, 248, 141, 200, 279, 221, 203, 220, 291, 362, 265, 132, 225, 
    250, 182, 257, 339, 306, 226, 216, 301, 343, 355, 420, 145, 310, 77, 422, 
    300, 135, 246, 381, 180, 311, 238, 229, 256, 380, 211, 261, 239, 145, 175, 
    205, 335, 275, 324, 266, 236, 231, 205, 216, 235, 261, 393, 180, 181, 263, 
    294, 321, 436, 363, 271, 224, 204, 243, 195, 110, 313, 190, 254, 213, 252, 
    106, 336, 253, 363, 239, 366, 274, 338, 209, 203, 83, 235, 328, 269, 267, 
    322, 366, 294, 277, 284, 221, 405, 367, 211, 237, 351, 214, 235, 163, 265, 
    259, 230, 348, 284, 145, 178, 412, 366, 233, 222, 133, 347, 337, 223, 266, 
    263, 282, 130, 182, 310, 236, 206, 215, 405, 215, 212, 357, 261, 246, 230, 
    145, 272, 217, 267, 254, 272, 204, 280, 278, 232, 287, 289, 281, 201, 153, 
    195, 168, 296, 232, 190, 305, 223, 247, 280, 325, 217, 328, 200, 335, 202, 
    338, 296, 290, 268, 298, 372, 277, 255, 295, 291, 378, 336, 301, 334, 360, 
    321, 340, 319, 292, 352, 340, 192, 198, 285, 366, 144, 166, 178, 267, 194, 
    257, 227, 434, 251, 303, 276, 182, 332, 296, 269, 393, 413, 162, 234, 288, 
    188, 200, 280, 321, 223, 210, 188, 200, 321, 201, 263, 366, 278, 246, 337, 
    366, 384, 366, 189, 255, 136, 292, 229, 259, 414, 207, 369, 277, 198, 235, 
    248, 398, 197, 222, 388, 244, 319, 325, 221, 372, 340, 301, 275, 243, 368, 
    195, 251, 274, 338, 274, 185, 89, 199, 288, 225, 425, 203, 145, 288, 67, 
    184, 203, 221, 313, 231, 292, 288, 312, 137, 169, 182, 131, 188, 173, 194, 
    228, 318, 235, 220, 289, 191, 264, 199, 369, 379, 174, 317, 207, 252, 329, 
    218, 222, 257, 368, 250, 235, 297, 231, 228, 286, 228, 148, 325, 272, 112, 
    273, 302, 291, 302, 284, 303, 185, 328, 433, 253, 391, 284, 284, 278, 109, 
    248, 245, 204, 122, 183, 221, 308, 359, 202, 307, 223, 173, 249, 263, 156, 
    240, 289, 239, 246, 95, 345, 329, 255, 327, 216, 276, 296, 285, 203, 282, 
    231, 184, 228, 245, 255, 179, 205, 285, 53, 264, 148, 306, 349, 376, 136, 
    159, 237, 189, 350, 150, 339, 205, 307, 379, 334, 459, 255, 223, 270, 329, 
    332, 317, 111, 344, 246, 250, 247, 224, 329, 193, 226, 233, 282, 170, 349, 
    233, 404, 174, 174, 375, 151, 329, 302, 202, 223, 239, 248, 250, 317, 170, 
    220, 128, 263, 207, 298, 340, 384, 272, 224, 290, 268, 293, 281, 229, 312, 
    227, 221, 318, 170, 305, 222, 193, 226, 124, 227, 277, 134, 226, 250, 359, 
    291, 245, 335, 439, 305, 247, 231, 363, 268, 252, 220, 297, 158, 269, 252, 
    252, 317, 317, 256, 413, 324, 223, 247, 245, 190, 366, 375, 281, 174, 205, 
    181, 284, 234, 469, 138, 362, 299, 269, 172, 333, 244, 272, 209, 263, 219, 
    271, 268, 269, 215, 246, 299, 270, 169, 345, 308, 271, 348, 313, 172, 274, 
    374, 309, 224, 281, 143, 356, 337, 286, 243, 144, 164, 166, 184, 285, 321, 
    209, 127, 233, 236, 262, 290, 188, 175, 326, 259, 163, 269, 464, 322, 174, 
    217, 321, 277, 316, 457, 219, 244, 211, 166, 224, 292, 255, 258, 234, 268, 
    267, 233, 251, 137, 158, 210, 289, 252, 142, 116, 220, 212, 248, 247, 123, 
    149, 124, 264, 200, 145, 263, 185, 230, 122, 182, 167, 281, 222, 285, 300, 
    334, 128, 210, 250, 274, 212, 191, 293, 173, 290, 221, 141, 166, 262, 153, 
    291, 210, 417, 193, 263, 295, 220, 178, 339, 124, 387, 279, 177, 266, 112, 
    166, 208, 331, 159, 126, 335, 222, 327, 222, 234, 186, 160, 282, 214, 263, 
    248, 316, 225, 179, 383, 195, 250, 141, 89, 259, 224, 212, 233, 219, 242, 
    275, 305, 262, 407, 280, 326, 265, 336, 157, 269, 177, 216, 193, 353, 147, 
    191, 316, 168, 252, 215, 267, 355, 280, 236, 300, 220, 294, 177, 229, 355, 
    272, 312, 301, 311, 170, 135, 234, 197, 287, 348, 238, 295, 261, 396, 255, 
    324, 201, 247, 248, 243, 178, 249, 218, 285, 245, 200, 338, 176, 242, 381, 
    196, 315, 143, 313, 202, 317, 382, 165, 168, 221, 225, 149, 307, 273, 294, 
    215, 215, 314, 187, 302, 250, 206, 324, 157, 345, 254, 155, 358, 369, 287, 
    341, 255, 180, 97, 297, 387, 254, 308, 266, 125, 281, 164, 289, 353, 342, 
    230
};
#endif
```

## src/array_include.h
```c
#ifndef ARRAY_INCLUDE_H
#define ARRAY_INCLUDE_H
typedef int INT_TYPE;

// Von außen setzbar: west build ... -- -DIS_CLASS=<M|S|P|W|A> (siehe build_is.sh)
#ifndef CLASS
#define CLASS 'M'
#endif



#if CLASS == 'M'
    #include "array_class_m.h"
#elif CLASS == 'S'
    #include "array_class_s.h"
#elif CLASS == 'A'
    #include "array_class_a.h"
#elif CLASS == 'P'
    #include "array_class_p.h"
#elif CLASS == 'W'
    #include "array_class_w.h"
#else
    #error "Invalid or undefined CLASS"
#endif


#define  TOTAL_KEYS          (1 << TOTAL_KEYS_LOG_2)
#define  MAX_KEY             (1 << MAX_KEY_LOG_2)
#define  NUM_BUCKETS         (1 << NUM_BUCKETS_LOG_2)
#define  NUM_KEYS            TOTAL_KEYS
#define  SIZE_OF_BUFFERS     NUM_KEYS  

#define  MAX_ITERATIONS      1
#define  TEST_ARRAY_SIZE     5

extern INT_TYPE *key_buff_ptr_global;
#endif
```

## src/main2.c
```c
#include <zephyr/kernel.h>
#include <zephyr/sys/printk.h>
#include <stdlib.h>
#include <stdint.h>

/* Use buckets to match the OpenMP logic */
#define USE_BUCKETS
#define SIMDEV_CORE_DONE (*(volatile unsigned int *)(0x1E203000))
#define MULTICORE_SIMDEV_CORE_DONE (*(volatile unsigned int *)(0x1C203000))

#define GET_SIM_TIME (*(volatile uint32_t *)(0x1E203020))
#define MULTICORE_SIM_DEV_GET_SIM_TIME (*(volatile uint32_t *)(0x1C203020))

/* Custom Nano Class for ultra-fast Simulator testing */
#define CLASS 'S'

#if CLASS == 'N'
#define  TOTAL_KEYS_LOG_2    10  // 1,024 keys
#define  MAX_KEY_LOG_2       7   // Max key 128
#define  NUM_BUCKETS_LOG_2   5   // 32 buckets
#endif

#if CLASS == 'M'
#define  TOTAL_KEYS_LOG_2    12  // 4,096 keys (down from 65,536)
#define  MAX_KEY_LOG_2       9   // Max key 512
#define  NUM_BUCKETS_LOG_2   7   // 128 buckets
#endif

#if CLASS == 'S'
#define  TOTAL_KEYS_LOG_2    16
#define  MAX_KEY_LOG_2       11
#define  NUM_BUCKETS_LOG_2   9
#endif

#define  TOTAL_KEYS          (1 << TOTAL_KEYS_LOG_2)
#define  MAX_KEY             (1 << MAX_KEY_LOG_2)
#define  NUM_BUCKETS         (1 << NUM_BUCKETS_LOG_2)
#define  NUM_KEYS            TOTAL_KEYS
#define  SIZE_OF_BUFFERS     NUM_KEYS  

#define  MAX_ITERATIONS      10
#define  TEST_ARRAY_SIZE     5

typedef int INT_TYPE;

INT_TYPE *key_buff_ptr_global;
int      passed_verification;

/* --- Zephyr SMP Threading Setup --- */
#define STACK_SIZE 2048
#define THREAD_PRIORITY 7

K_THREAD_STACK_DEFINE(core1_stack, STACK_SIZE);
struct k_thread core1_thread_data;

/* Semaphores for barrier synchronization */
K_SEM_DEFINE(core1_start_sem, 0, 1);
K_SEM_DEFINE(core1_done_sem, 0, 1);

/* Per-core bucket histograms */
INT_TYPE bucket_size_core0[NUM_BUCKETS];
INT_TYPE bucket_size_core1[NUM_BUCKETS];

/* The large static arrays */
INT_TYPE key_array[SIZE_OF_BUFFERS],    
         key_buff1[MAX_KEY],    
         key_buff2[SIZE_OF_BUFFERS],
         partial_verify_vals[TEST_ARRAY_SIZE];

#ifdef USE_BUCKETS
INT_TYPE bucket_size[NUM_BUCKETS],                    
         bucket_ptrs[NUM_BUCKETS];
#endif

INT_TYPE test_index_array[TEST_ARRAY_SIZE],
         test_rank_array[TEST_ARRAY_SIZE],
         /* Safe indices for the Nano 1024-element array */
         S_test_index_array[TEST_ARRAY_SIZE] = {10, 50, 100, 150, 200},
         S_test_rank_array[TEST_ARRAY_SIZE]  = {0, 0, 0, 0, 0};

/* Portable random number generator */
double randlc(double *X, double *A) {
      static int KS = 0;
      static double R23, R46, T23, T46;
      double T1, T2, T3, T4, A1, A2, X1, X2, Z;
      int i, j;

      if (KS == 0) {
        R23 = 1.0; R46 = 1.0; T23 = 1.0; T46 = 1.0;
        for (i=1; i<=23; i++) { R23 = 0.50 * R23; T23 = 2.0 * T23; }
        for (i=1; i<=46; i++) { R46 = 0.50 * R46; T46 = 2.0 * T46; }
        KS = 1;
      }

      T1 = R23 * *A; j = T1; A1 = j; A2 = *A - T23 * A1;
      T1 = R23 * *X; j = T1; X1 = j; X2 = *X - T23 * X1;
      T1 = A1 * X2 + A2 * X1;
      
      j  = R23 * T1; T2 = j; Z = T1 - T23 * T2;
      T3 = T23 * Z + A2 * X2;
      j  = R46 * T3; T4 = j; *X = T3 - T46 * T4;
      return(R46 * *X);
} 

/* Generate random number sequence and subsequent keys */
void create_seq(double seed, double a) {
    double x;
    int i, k = MAX_KEY / 4;
    printk("Generating 65,536 keys (Soft-Float math is slow). Please wait");
    for (i = 0; i < NUM_KEYS; i++) {
        x = randlc(&seed, &a);
        x += randlc(&seed, &a);
        x += randlc(&seed, &a);
        x += randlc(&seed, &a);  
        key_array[i] = k * x;
        // printk("create_seq: i = %d, out of %d\n", i, NUM_KEYS);
        if ((i % 4096) == 0) {
            printk("%d ", i);
        }
    }
}

void full_verify(void) {
    INT_TYPE i, j;
#ifndef USE_BUCKETS
    for(i = 0; i < NUM_KEYS; i++)
        key_buff2[i] = key_array[i];
#endif
    for(i = 0; i < NUM_KEYS; i++)
        key_array[--key_buff_ptr_global[key_buff2[i]]] = key_buff2[i];

    j = 0;
    for(i = 1; i < NUM_KEYS; i++)
        if(key_array[i-1] > key_array[i]) j++;

    if(j != 0) {
        printk("Full_verify: number of keys out of sort: %d\n", j);
    } else {
        passed_verification++;
    }
}

/* Worker function running strictly on Core 1 */
void core1_worker_thread(void *arg1, void *arg2, void *arg3) {
    int shift = MAX_KEY_LOG_2 - NUM_BUCKETS_LOG_2;
    int start_idx = NUM_KEYS / 2;
    int end_idx = NUM_KEYS;

    while (1) {
        /* Wait for Core 0 to signal start */
        k_sem_take(&core1_start_sem, K_FOREVER);

        /* Core 1's work: Histogram of second half of keys */
        for (int i = 0; i < NUM_BUCKETS; i++) bucket_size_core1[i] = 0;
        for (int i = start_idx; i < end_idx; i++) {
            bucket_size_core1[key_array[i] >> shift]++;
        }

        /* Signal Core 0 that Core 1 is finished */
        k_sem_give(&core1_done_sem);
    }
}

void rank(int iteration) {
    INT_TYPE i, k, *key_buff_ptr, *key_buff_ptr2;
#ifdef USE_BUCKETS
    int shift = MAX_KEY_LOG_2 - NUM_BUCKETS_LOG_2;
    INT_TYPE key;
#endif

    key_array[iteration] = iteration;
    key_array[iteration + MAX_ITERATIONS] = MAX_KEY - iteration;

    for(i = 0; i < TEST_ARRAY_SIZE; i++){
        partial_verify_vals[i] = key_array[test_index_array[i]];
    }

#ifdef USE_BUCKETS
    /* ============================================================ */
    /* PARALLEL SECTION: Dual-Core Bucket Counting                  */
    /* ============================================================ */
    
    /* 1. Wake up Core 1 */
    k_sem_give(&core1_start_sem);

    /* 2. Core 0 does its work on the first half of keys in parallel */
    for (i = 0; i < NUM_BUCKETS; i++) bucket_size_core0[i] = 0;
    for (i = 0; i < NUM_KEYS / 2; i++) {
        bucket_size_core0[key_array[i] >> shift]++;
    }

    /* 3. Wait for Core 1 to finish */
    k_sem_take(&core1_done_sem, K_FOREVER);

    /* 4. Combine results (Reduction) */
    for (i = 0; i < NUM_BUCKETS; i++) {
        bucket_size[i] = bucket_size_core0[i] + bucket_size_core1[i];
    }
    
    /* ============================================================ */
    
    bucket_ptrs[0] = 0;
    for(i = 1; i < NUM_BUCKETS; i++)  
        bucket_ptrs[i] = bucket_ptrs[i-1] + bucket_size[i-1];

    for(i = 0; i < NUM_KEYS; i++) {
        key = key_array[i];
        key_buff2[bucket_ptrs[key >> shift]++] = key;
    }
    key_buff_ptr2 = key_buff2;
#else
    key_buff_ptr2 = key_array;
#endif

    for(i = 0; i < MAX_KEY; i++) key_buff1[i] = 0;
    
    key_buff_ptr = key_buff1;
    for(i = 0; i < NUM_KEYS; i++) key_buff_ptr[key_buff_ptr2[i]]++;  
    for(i = 0; i < MAX_KEY-1; i++) key_buff_ptr[i+1] += key_buff_ptr[i];  

    for(i = 0; i < TEST_ARRAY_SIZE; i++) {   
        k = partial_verify_vals[i];          
        if(0 < k && k <= NUM_KEYS-1) {
            INT_TYPE key_rank = key_buff_ptr[k-1];
            int failed = 0;
            if(i <= 2) {
                if(key_rank != test_rank_array[i] + iteration) failed = 1;
                else passed_verification++;
            } else {
                if(key_rank != test_rank_array[i] - iteration) failed = 1;
                else passed_verification++;
            }
        }
    }
    if(iteration == MAX_ITERATIONS) key_buff_ptr_global = key_buff_ptr;
}      

int main(void) {
    int i, iteration;

    /* Initialize the verification arrays */
    for(i = 0; i < TEST_ARRAY_SIZE; i++) {
        test_index_array[i] = S_test_index_array[i];
        test_rank_array[i]  = S_test_rank_array[i];
    }

    printk("\n\n NAS Parallel Benchmarks (Zephyr SMP) - IS Benchmark\n\n");
    printk(" Size:  %d  (class %c)\n", TOTAL_KEYS, CLASS);
    printk(" Iterations:   %d\n", MAX_ITERATIONS);

    /* Spawn Core 1 Worker Thread */
    k_thread_create(&core1_thread_data, core1_stack,
                    K_THREAD_STACK_SIZEOF(core1_stack),
                    core1_worker_thread,
                    NULL, NULL, NULL,
                    THREAD_PRIORITY, 0, K_NO_WAIT);

    /* Initialization phase */
    create_seq(314159265.00, 1220703125.00);                 

    /* Do one iteration untimed to guarantee initialization of tables */
    passed_verification = 0;
    
    printk("\n   iteration\n");
    
    /* START TIMER */
    rank(1);  
    printk("Initialization done, counting time\n");
    printk("Sim time: %u\n", MULTICORE_SIM_DEV_GET_SIM_TIME);
    
    for(iteration = 1; iteration <= MAX_ITERATIONS; iteration++) {
        printk("        %d\n", iteration);
        rank(iteration);
    }

    /* Final verification */
    full_verify();

    /* Removed strict partial verification check for custom Nano class */
    // if(passed_verification != 5 * MAX_ITERATIONS + 1) passed_verification = 0;

    printk("\n===================================\n");
    printk("Verification: %s\n", passed_verification ? "SUCCESSFUL" : "FAILED");
    printk("===================================\n");
    MULTICORE_SIMDEV_CORE_DONE = 1;
    MULTICORE_SIMDEV_CORE_DONE = 0;
    return 0;
}
```

## src/mainhello.c
```c
#include <zephyr/kernel.h>
#include <zephyr/sys/printk.h>
#include <stdlib.h>
#include <stdint.h>
/* --- HIER WIRD DAS ARRAY GELADEN --- */



int main(void) {
    printk("Hello world");
    return 0;
}
```
