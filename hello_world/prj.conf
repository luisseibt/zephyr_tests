## CMakeLists.txt
```
 ##############################################################################
 #                                                                            #
 # Copyright (C) 2025 Nils Bosbach                                            #
 # All Rights Reserved                                                        #
 #                                                                            #
 # This is work is licensed under the terms described in the LICENSE file     #
 # found in the root directory of this source tree.                           #
 #                                                                            #
 ##############################################################################

cmake_minimum_required(VERSION 3.20)

# set(DTC_OVERLAY_FILE "${CMAKE_CURRENT_SOURCE_DIR}/boards/pydro32.overlay")
list(APPEND EXTRA_ZEPHYR_MODULES ${CMAKE_CURRENT_SOURCE_DIR}/../zephyr_modules/custom_uart)
find_package(Zephyr REQUIRED HINTS $ENV{ZEPHYR_BASE})

project(hello)

target_sources(app PRIVATE
    ${CMAKE_CURRENT_SOURCE_DIR}/src/main.c
)

target_include_directories(app PRIVATE include)
```

## prj.conf
```kconfig
 ##############################################################################
 #                                                                            #
 # Copyright (C) 2025 Nils Bosbach                                            #
 # All Rights Reserved                                                        #
 #                                                                            #
 # This is work is licensed under the terms described in the LICENSE file     #
 # found in the root directory of this source tree.                           #
 #                                                                            #
 ##############################################################################

# CONFIG_VCML_SIMDEV=y
# Cache management
CONFIG_CACHE_MANAGEMENT=y
CONFIG_SYS_CLOCK_EXISTS=y
# Enable UART driver
CONFIG_SERIAL=y

# Enable console
CONFIG_CONSOLE=y
CONFIG_UART_CONSOLE=y

# Enable serial port
# CONFIG_UART_PL011=y
CONFIG_UART_INTERRUPT_DRIVEN=y

# SMP-related
CONFIG_SMP=n

CONFIG_MP_MAX_NUM_CPUS=1
# CONFIG_TIMEOUT_64BIT=y


CONFIG_LOG=y
CONFIG_LOG_DEFAULT_LEVEL=3
CONFIG_LOG_BACKEND_UART=y
#CONFIG_LOG_BUFFER_SIZE=0
CONFIG_LOG_MODE_IMMEDIATE=y

CONFIG_KERNEL_VM_SIZE=0x80000000

CONFIG_MINIMAL_LIBC=y
CONFIG_MINIMAL_LIBC_OPTIMIZE_STRING_FOR_SIZE=n
```

## src/main.c
```c
#include <string.h>
#include <zephyr/kernel.h>
#include <zephyr/logging/log.h>
#include <zephyr/logging/log_ctrl.h>


#define STACKSIZE 2048
#define PRIORITY  7

LOG_MODULE_REGISTER(main);

// devices
// static const struct device* simdev = DEVICE_DT_GET(DT_NODELABEL(simdev));

int init() {
    // if (!simdev) {
    //     LOG_ERR("simdev not found in device tree");
    //     return 1;
    // }
    // if (!device_is_ready(simdev)) {
    //     LOG_ERR("simdev not ready");
    //     return 1;
    // }

    return 0;
}

int main() {
    int init_ret = init();
    if (init_ret != 0)
        return init_ret;

    LOG_INF("Hello World");
    LOG_INF("Stopping in 1s...");
    log_flush();
    k_sleep(K_MSEC(1000));

    // vcml_simdev_stop(simdev, 0);
    return 0;
}
```
