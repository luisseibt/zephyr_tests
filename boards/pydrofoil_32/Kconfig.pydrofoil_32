## boards/pydrofoil_32/Kconfig.pydrofoil_32
```kconfig
# Copyright (c) 2024 Antmicro <www.antmicro.com>
# SPDX-License-Identifier: Apache-2.0

config BOARD_PYDROFOIL_32
	select SOC_PYDROFOIL_RISCV32
```

## boards/pydrofoil_32/board.yml
```yaml
board:
  name: pydrofoil_32
  full_name: Pydrofoil 32-bit Virtual Prototype
  vendor: pydrofoil
  socs:
    - name: pydrofoil_riscv32
```

## soc/pydrofoil/Kconfig
```kconfig
config SOC_FAMILY_PYDROFOIL_RISCV
	select INCLUDE_RESET_VECTOR
	select RISCV
	select RISCV_PRIVILEGED
	select RISCV_SOC_HAS_GP_RELATIVE_ADDRESSING
	imply XIP

if SOC_FAMILY_PYDROFOIL_RISCV

rsource "*/Kconfig"

endif # SOC_FAMILY_PYDROFOIL_RISCV
```

## soc/pydrofoil/Kconfig.soc
```kconfig
config SOC_FAMILY_PYDROFOIL_RISCV
	bool

config SOC_FAMILY
	default "pydrofoil_riscv" if SOC_FAMILY_PYDROFOIL_RISCV

rsource "*/Kconfig.soc"
```

## soc/pydrofoil/pydrofoil_riscv32/Kconfig.soc
```kconfig
config SOC_PYDROFOIL_RISCV32
	bool
	select SOC_FAMILY_PYDROFOIL_RISCV

config SOC
	default "pydrofoil_riscv32" if SOC_PYDROFOIL_RISCV32
```

## zephyr_modules/custom_uart/drivers/serial/uart_pydrofoil/Kconfig
```kconfig
config UART_PYDROFOIL
	bool "Pydrofoil nRF51 UART emulator driver"
	default y
	depends on DT_HAS_PYDROFOIL_NRF_UART_ENABLED
	select SERIAL_HAS_DRIVER
	help
	  Enable the custom Pydrofoil UART emulator driver for VCML.
```

## zephyr_modules/custom_uart/dts/bindings/serial/pydrofoil,nrf-uart.yaml
```yaml
description: Custom Pydrofoil nRF51 UART Emulator
compatible: "pydrofoil,nrf-uart"

include: uart-controller.yaml
```
